## conf/layer.conf
```bitbake
# We have a conf and classes directory, add to BBPATH
BBPATH .= ":${LAYERDIR}"

# We have recipes-* directories, add to BBFILES
BBFILES += "${LAYERDIR}/recipes-*/*/*.bb \
        ${LAYERDIR}/recipes-*/*/*.bbappend"

BBFILE_COLLECTIONS += "jami-imx"
BBFILE_PATTERN_jami-imx = "^${LAYERDIR}/"
BBFILE_PRIORITY_jami-imx = "6"

LAYERSERIES_COMPAT_jami-imx = "hardknott"
LAYERDEPENDS_jami-imx = "core freescale-layer"
```
